## configs/ifc6410_wpe_defconfig
```kconfig
# Architecture
BR2_arm=y
BR2_ARM_EABIHF=y
BR2_ARM_CPU_HAS_VFPV4=y
BR2_ARM_FPU_VFPV4=y
BR2_ARM_INSTRUCTIONS_THUMB2=y

# Compiler
BR2_GCC_VERSION_4_9_X=y
BR2_GCC_VERSION="4.9.2"
BR2_OPTIMIZE_2=y
BR2_TARGET_OPTIMIZATION="-pipe -mabi=aapcs-linux -mfloat-abi=hard -march=armv7-a -mfpu=vfpv4 -mthumb"

# Lock to 3.4 headers
BR2_KERNEL_HEADERS_3_4=y

BR2_TOOLCHAIN_BUILDROOT=y
BR2_TOOLCHAIN_BUILDROOT_GLIBC=y
BR2_TOOLCHAIN_BUILDROOT_CXX=y
BR2_GLIBC_VERSION_2_20=y

BR2_TARGET_GENERIC_GETTY=y
BR2_TARGET_GENERIC_GETTY_PORT="tty1"
BR2_TARGET_GENERIC_ROOT_PASSWD="root"

BR2_PACKAGE_DROPBEAR=y
BR2_PACKAGE_NTP=y
BR2_PACKAGE_NTP_NTPD=y
BR2_PACKAGE_NTP_NTPDATE=y

BR2_PACKAGE_TZDATA=y
BR2_TARGET_TZ_INFO=y
BR2_TARGET_TZ_ZONELIST="default"
BR2_TARGET_LOCALTIME="America/Los_Angeles"

BR2_ROOTFS_DEVICE_CREATION_DYNAMIC_EUDEV=y
BR2_PACKAGE_EUDEV=y

BR2_PACKAGE_LIBDRM=y
BR2_PACKAGE_LIBDRM_FREEDRENO=y
BR2_PACKAGE_WAYLAND=y
BR2_PACKAGE_MESA3D=y
BR2_PACKAGE_MESA3D_GALLIUM_DRIVER_FREEDRENO=y
BR2_PACKAGE_MESA3D_OPENGL_EGL=y
BR2_PACKAGE_MESA3D_OPENGL_ES=y
BR2_PACKAGE_KMSCUBE=y
BR2_PACKAGE_WESTON=y
BR2_PACKAGE_WESTON_DRM=y
BR2_PACKAGE_WESTON_EGL=y

BR2_PACKAGE_GSTREAMER1=y
BR2_PACKAGE_GST_OMX=y
BR2_PACKAGE_GST1_PLUGINS_BASE_PLUGIN_APP=y
BR2_PACKAGE_GST1_PLUGINS_BASE_PLUGIN_VIDEOCONVERT=y
BR2_PACKAGE_GST1_PLUGINS_GOOD=y
BR2_PACKAGE_GST1_PLUGINS_GOOD_PLUGIN_AUDIOPARSERS=y
BR2_PACKAGE_GST1_PLUGINS_GOOD_PLUGIN_AUTODETECT=y
BR2_PACKAGE_GST1_PLUGINS_GOOD_PLUGIN_DEINTERLACE=y
BR2_PACKAGE_GST1_PLUGINS_GOOD_PLUGIN_ISOMP4=y
BR2_PACKAGE_GST1_PLUGINS_GOOD_PLUGIN_MATROSKA=y
BR2_PACKAGE_GST1_PLUGINS_GOOD_PLUGIN_SOUPHTTPSRC=y
BR2_PACKAGE_GST1_PLUGINS_GOOD_PLUGIN_V4L2=y
BR2_PACKAGE_GST1_PLUGINS_BAD=y
BR2_PACKAGE_GST1_PLUGINS_BAD_PLUGIN_DASH=y
BR2_PACKAGE_GST1_PLUGINS_BAD_PLUGIN_GL=y
BR2_PACKAGE_GST1_PLUGINS_BAD_PLUGIN_HLS=y
BR2_PACKAGE_GST1_PLUGINS_BAD_PLUGIN_LIBMMS=y
BR2_PACKAGE_GST1_PLUGINS_BAD_PLUGIN_MPEGTSDEMUX=y
BR2_PACKAGE_GST1_PLUGINS_BAD_PLUGIN_VIDEOPARSERS=y

BR2_PACKAGE_WPE=y
BR2_PACKAGE_WPE_DEMOS=y
BR2_PACKAGE_DEJAVU=y
BR2_PACKAGE_SHARED_MIME_INFO=y
```

## configs/jetson_tk1_wpe_defconfig
```kconfig
# Some additional tasks required.
BR2_ROOTFS_POST_BUILD_SCRIPT="board/jetson-tk1/post-build.sh"

# Architecture
BR2_arm=y
BR2_cortex_a15=y
BR2_ARM_EABIHF=y
BR2_ARM_CPU_HAS_VFPV4=y
BR2_ARM_FPU_VFPV4=y
BR2_ARM_INSTRUCTIONS_THUMB2=y

# Compiler
BR2_GCC_VERSION_4_9_X=y
BR2_GCC_VERSION="4.9.2"
BR2_OPTIMIZE_2=y
BR2_TARGET_OPTIMIZATION="-pipe -mabi=aapcs-linux -mfloat-abi=hard -mcpu=cortex-a15 -mfpu=vfpv4 -mthumb"

# Lock to 3.18 headers
BR2_KERNEL_HEADERS_VERSION=y
BR2_DEFAULT_KERNEL_VERSION="3.18"
BR2_PACKAGE_HOST_LINUX_HEADERS_CUSTOM_3_18=y

# Linux kernel
BR2_LINUX_KERNEL=y
BR2_LINUX_KERNEL_CUSTOM_GIT=y
BR2_LINUX_KERNEL_CUSTOM_REPO_URL="https://github.com/zdobersek/linux.git"
BR2_LINUX_KERNEL_CUSTOM_REPO_VERSION="550688cfbe21170b89a5b8c39c70fe2eef340b15"
BR2_LINUX_KERNEL_USE_DEFCONFIG=y
BR2_LINUX_KERNEL_DEFCONFIG="tegra"
BR2_LINUX_KERNEL_ZIMAGE=y
BR2_LINUX_KERNEL_DTS_SUPPORT=y
BR2_LINUX_KERNEL_USE_INTREE_DTS=y
BR2_LINUX_KERNEL_INTREE_DTS_NAME="tegra124-jetson-tk1"

BR2_TOOLCHAIN_BUILDROOT=y
BR2_TOOLCHAIN_BUILDROOT_GLIBC=y
BR2_TOOLCHAIN_BUILDROOT_CXX=y
BR2_GLIBC_VERSION_2_20=y

BR2_TARGET_GENERIC_GETTY=y
BR2_TARGET_GENERIC_GETTY_PORT="tty1"
BR2_TARGET_GENERIC_ROOT_PASSWD="root"

BR2_PACKAGE_DROPBEAR=y
BR2_PACKAGE_NTP=y
BR2_PACKAGE_NTP_NTPD=y
BR2_PACKAGE_NTP_NTPDATE=y

BR2_PACKAGE_TZDATA=y
BR2_TARGET_TZ_INFO=y
BR2_TARGET_TZ_ZONELIST="default"
BR2_TARGET_LOCALTIME="America/Los_Angeles"

BR2_ROOTFS_DEVICE_CREATION_DYNAMIC_EUDEV=y
BR2_PACKAGE_EUDEV=y

BR2_PACKAGE_LINUX_FIRMWARE=y
BR2_PACKAGE_LINUX_FIRMWARE_NVIDIA_GK20A=y
BR2_PACKAGE_NOUVEAU_DRM=y
BR2_PACKAGE_LIBDRM=y
BR2_PACKAGE_LIBDRM_NOUVEAU=y
BR2_PACKAGE_LIBDRM_TEGRA=y
BR2_PACKAGE_WAYLAND=y
BR2_PACKAGE_MESA3D=y
BR2_PACKAGE_MESA3D_GALLIUM_DRIVER_NOUVEAU=y
BR2_PACKAGE_MESA3D_OPENGL_EGL=y
BR2_PACKAGE_MESA3D_OPENGL_ES=y
BR2_PACKAGE_KMSCUBE=y
BR2_PACKAGE_WESTON=y
BR2_PACKAGE_WESTON_DRM=y
BR2_PACKAGE_WESTON_EGL=y

# FIXME: Add proper support for video playback.
# BR2_PACKAGE_GSTREAMER1=y
# BR2_PACKAGE_GST_OMX=y
# BR2_PACKAGE_GST1_PLUGINS_BASE_PLUGIN_APP=y
# BR2_PACKAGE_GST1_PLUGINS_BASE_PLUGIN_VIDEOCONVERT=y
# BR2_PACKAGE_GST1_PLUGINS_GOOD=y
# BR2_PACKAGE_GST1_PLUGINS_GOOD_PLUGIN_AUDIOPARSERS=y
# BR2_PACKAGE_GST1_PLUGINS_GOOD_PLUGIN_AUTODETECT=y
# BR2_PACKAGE_GST1_PLUGINS_GOOD_PLUGIN_DEINTERLACE=y
# BR2_PACKAGE_GST1_PLUGINS_GOOD_PLUGIN_ISOMP4=y
# BR2_PACKAGE_GST1_PLUGINS_GOOD_PLUGIN_MATROSKA=y
# BR2_PACKAGE_GST1_PLUGINS_GOOD_PLUGIN_SOUPHTTPSRC=y
# BR2_PACKAGE_GST1_PLUGINS_GOOD_PLUGIN_V4L2=y
# BR2_PACKAGE_GST1_PLUGINS_BAD=y
# BR2_PACKAGE_GST1_PLUGINS_BAD_PLUGIN_DASH=y
# BR2_PACKAGE_GST1_PLUGINS_BAD_PLUGIN_GL=y
# BR2_PACKAGE_GST1_PLUGINS_BAD_PLUGIN_HLS=y
# BR2_PACKAGE_GST1_PLUGINS_BAD_PLUGIN_LIBMMS=y
# BR2_PACKAGE_GST1_PLUGINS_BAD_PLUGIN_MPEGTSDEMUX=y
# BR2_PACKAGE_GST1_PLUGINS_BAD_PLUGIN_VIDEOPARSERS=y

BR2_PACKAGE_WPE=y
BR2_PACKAGE_WPE_DEMOS=y
BR2_PACKAGE_DEJAVU=y
BR2_PACKAGE_SHARED_MIME_INFO=y

# Enable when required.
# BR2_GDB_VERSION_7_7=y
# BR2_PACKAGE_GDB=y
# BR2_PACKAGE_GDB_SERVER=y
# BR2_PACKAGE_ELFUTILS=y
# BR2_PACKAGE_PERF=y
# CONFIG_HAVE_PERF_EVENTS=y
# CONFIG_KALLSYMS=y
# CONFIG_KALLSYMS_ALL=y
```

## configs/minnowboard_max_wpe_defconfig
```kconfig
# Architecture
BR2_x86_64=y
BR2_x86_atom=y

# Misc
BR2_TARGET_GENERIC_GETTY_PORT="ttyS0"
BR2_SYSTEM_DHCP="enp2s0"
BR2_ROOTFS_POST_BUILD_SCRIPT="board/minnowboard-max/post-build.sh"

# Compiler
BR2_GCC_VERSION_4_9_X=y
BR2_GCC_VERSION="4.9.2"
BR2_OPTIMIZE_2=y

# Lock to 3.17 headers to avoid breaking with newer kernels
BR2_KERNEL_HEADERS_VERSION=y
BR2_DEFAULT_KERNEL_VERSION="3.18.6"
BR2_PACKAGE_HOST_LINUX_HEADERS_CUSTOM_3_18=y

# Needed for ethernet
BR2_PACKAGE_LINUX_FIRMWARE=y
BR2_PACKAGE_LINUX_FIRMWARE_RTL_8169=y

# Linux kernel
BR2_LINUX_KERNEL=y
BR2_LINUX_KERNEL_CUSTOM_VERSION=y
BR2_LINUX_KERNEL_CUSTOM_VERSION_VALUE="3.18.6"
BR2_LINUX_KERNEL_USE_CUSTOM_CONFIG=y
BR2_LINUX_KERNEL_CUSTOM_CONFIG_FILE="board/minnowboard-max/linux-3.18.config"

# Bootloader
BR2_TARGET_GRUB2=y
BR2_TARGET_GRUB2_X86_64_EFI=y

BR2_TOOLCHAIN_BUILDROOT=y
BR2_TOOLCHAIN_BUILDROOT_GLIBC=y
BR2_TOOLCHAIN_BUILDROOT_CXX=y
BR2_GLIBC_VERSION_2_20=y

BR2_TARGET_GENERIC_GETTY=y
BR2_TARGET_GENERIC_GETTY_PORT="tty1"
BR2_TARGET_GENERIC_ROOT_PASSWD="root"

BR2_PACKAGE_DROPBEAR=y
BR2_PACKAGE_NTP=y
BR2_PACKAGE_NTP_NTPD=y
BR2_PACKAGE_NTP_NTPDATE=y

BR2_PACKAGE_TZDATA=y
BR2_TARGET_TZ_INFO=y
BR2_TARGET_TZ_ZONELIST="default"
BR2_TARGET_LOCALTIME="America/Los_Angeles"

BR2_ROOTFS_DEVICE_CREATION_DYNAMIC_EUDEV=y
BR2_PACKAGE_EUDEV=y

BR2_PACKAGE_LIBDRM=y
BR2_PACKAGE_LIBDRM_INTEL=y
BR2_PACKAGE_WAYLAND=y
BR2_PACKAGE_MESA3D=y
BR2_PACKAGE_MESA3D_DRI_DRIVER_I915=y
BR2_PACKAGE_MESA3D_DRI_DRIVER_I965=y
BR2_PACKAGE_MESA3D_OPENGL_EGL=y
BR2_PACKAGE_MESA3D_OPENGL_ES=y
BR2_PACKAGE_KMSCUBE=y
BR2_PACKAGE_WESTON=y
BR2_PACKAGE_WESTON_EGL=y
BR2_PACKAGE_WESTON_DRM=y

BR2_PACKAGE_GSTREAMER1=y
BR2_PACKAGE_GST_VAAPI=y
BR2_PACKAGE_GST1_PLUGINS_BASE_PLUGIN_APP=y
BR2_PACKAGE_GST1_PLUGINS_BASE_PLUGIN_VIDEOCONVERT=y
BR2_PACKAGE_GST1_PLUGINS_GOOD=y
BR2_PACKAGE_GST1_PLUGINS_GOOD_PLUGIN_AUDIOPARSERS=y
BR2_PACKAGE_GST1_PLUGINS_GOOD_PLUGIN_AUTODETECT=y
BR2_PACKAGE_GST1_PLUGINS_GOOD_PLUGIN_DEINTERLACE=y
BR2_PACKAGE_GST1_PLUGINS_GOOD_PLUGIN_ISOMP4=y
BR2_PACKAGE_GST1_PLUGINS_GOOD_PLUGIN_MATROSKA=y
BR2_PACKAGE_GST1_PLUGINS_GOOD_PLUGIN_SOUPHTTPSRC=y
BR2_PACKAGE_GST1_PLUGINS_GOOD_PLUGIN_V4L2=y
BR2_PACKAGE_GST1_PLUGINS_BAD=y
BR2_PACKAGE_GST1_PLUGINS_BAD_PLUGIN_DASH=y
BR2_PACKAGE_GST1_PLUGINS_BAD_PLUGIN_GL=y
BR2_PACKAGE_GST1_PLUGINS_BAD_PLUGIN_HLS=y
BR2_PACKAGE_GST1_PLUGINS_BAD_PLUGIN_LIBMMS=y
BR2_PACKAGE_GST1_PLUGINS_BAD_PLUGIN_MPEGTSDEMUX=y
BR2_PACKAGE_GST1_PLUGINS_BAD_PLUGIN_VIDEOPARSERS=y

BR2_PACKAGE_WPE=y
BR2_PACKAGE_WPE_DEMOS=y
BR2_PACKAGE_DEJAVU=y
BR2_PACKAGE_SHARED_MIME_INFO=y

# Enable as required.
# BR2_PACKAGE_ELFUTILS=y
# BR2_PACKAGE_PERF=y
# CONFIG_HAVE_PERF_EVENTS=y
# CONFIG_KALLSYMS=y
# CONFIG_KALLSYMS_ALL=y
```

## configs/odroid_u3_defconfig
```kconfig
# Architecture
BR2_arm=y
BR2_cortex_a9=y
BR2_ARM_EABIHF=y
BR2_ARM_CPU_HAS_VFPV3=y
BR2_ARM_FPU_VFPV3=y
BR2_ARM_CPU_HAS_NEON=y
BR2_ARM_ENABLE_NEON=y
BR2_ARM_INSTRUCTIONS_THUMB2=y

# Compiler
BR2_GCC_VERSION_4_9_X=y
BR2_GCC_VERSION="4.9.2"
BR2_OPTIMIZE_2=y
BR2_TARGET_OPTIMIZATION="-pipe -mabi=aapcs-linux -mfloat-abi=hard -mcpu=cortex-a9 -mfpu=vfpv3 -mthumb"

# Lock to 3.17 headers
BR2_KERNEL_HEADERS_VERSION=y
BR2_DEFAULT_KERNEL_VERSION="3.17.8"
BR2_PACKAGE_HOST_LINUX_HEADERS_CUSTOM_3_17=y

# Linux kernel
BR2_LINUX_KERNEL=y
BR2_LINUX_KERNEL_CUSTOM_GIT=y
BR2_LINUX_KERNEL_CUSTOM_REPO_URL="https://github.com/WebKitForWayland/linux.git"
BR2_LINUX_KERNEL_CUSTOM_REPO_VERSION="c62aa689933270ef609cd9f2d6bd79c8d04cf964"
BR2_LINUX_KERNEL_USE_DEFCONFIG=y
BR2_LINUX_KERNEL_DEFCONFIG="odroid"
BR2_LINUX_KERNEL_APPENDED_ZIMAGE=y
BR2_LINUX_KERNEL_DTS_SUPPORT=y
BR2_LINUX_KERNEL_USE_INTREE_DTS=y
BR2_LINUX_KERNEL_INTREE_DTS_NAME="exynos4412-odroidu3"

BR2_TOOLCHAIN_BUILDROOT=y
BR2_TOOLCHAIN_BUILDROOT_GLIBC=y
BR2_TOOLCHAIN_BUILDROOT_CXX=y
BR2_GLIBC_VERSION_2_20=y

BR2_SYSTEM_DHCP="eth0"
BR2_TARGET_GENERIC_GETTY=y
BR2_TARGET_GENERIC_GETTY_PORT="tty1"
BR2_TARGET_GENERIC_ROOT_PASSWD="root"

BR2_PACKAGE_TZDATA=y
BR2_TARGET_TZ_INFO=y
BR2_TARGET_TZ_ZONELIST="default"
BR2_TARGET_LOCALTIME="America/Los_Angeles"

BR2_PACKAGE_DROPBEAR=y
BR2_PACKAGE_NTP=y
BR2_PACKAGE_NTP_NTPD=y
BR2_PACKAGE_NTP_NTPDATE=y
```

## configs/raspberrypi2_wpe_defconfig
```kconfig
# Misc
BR2_SYSTEM_DHCP="eth0"
BR2_ROOTFS_POST_BUILD_SCRIPT="board/raspberrypi2/post-build.sh"

BR2_arm=y
BR2_cortex_a7=y
BR2_ARM_EABIHF=y
BR2_ARM_FPU_NEON_VFPV4=y
BR2_ARM_INSTRUCTIONS_THUMB2=y

BR2_GCC_VERSION_5_X=y
BR2_OPTIMIZE_2=y

BR2_TOOLCHAIN_BUILDROOT=y
BR2_TOOLCHAIN_BUILDROOT_GLIBC=y
BR2_TOOLCHAIN_BUILDROOT_CXX=y
BR2_GLIBC_VERSION_2_20=y

# Lock to 4.1 headers as the RPi kernel stable tree is
# based off the 4.1 branch
BR2_KERNEL_HEADERS_VERSION=y
BR2_DEFAULT_KERNEL_VERSION="4.1.8"
BR2_PACKAGE_HOST_LINUX_HEADERS_CUSTOM_4_1=y

BR2_LINUX_KERNEL=y
BR2_LINUX_KERNEL_CUSTOM_GIT=y
BR2_LINUX_KERNEL_CUSTOM_REPO_URL="https://github.com/anholt/linux.git"
BR2_LINUX_KERNEL_CUSTOM_REPO_VERSION="9268e6bf7ba2a6832c0288555bf592a63614a754"
BR2_LINUX_KERNEL_USE_CUSTOM_CONFIG=y
BR2_LINUX_KERNEL_CUSTOM_CONFIG_FILE="board/raspberrypi2/linux-4.1.config"
BR2_LINUX_KERNEL_ZIMAGE=y

# Build the DTB from the kernel sources
BR2_LINUX_KERNEL_DTS_SUPPORT=y
BR2_LINUX_KERNEL_INTREE_DTS_NAME="bcm2709-rpi-2-b"

BR2_PACKAGE_RPI_FIRMWARE=y

BR2_TARGET_GENERIC_GETTY=y
BR2_TARGET_GENERIC_GETTY_PORT="tty1"
BR2_TARGET_GENERIC_ROOT_PASSWD="root"

BR2_PACKAGE_DROPBEAR=y
BR2_PACKAGE_NTP=y
BR2_PACKAGE_NTP_NTPD=y
BR2_PACKAGE_NTP_NTPDATE=y

BR2_PACKAGE_TZDATA=y
BR2_TARGET_TZ_INFO=y
BR2_TARGET_TZ_ZONELIST="default"
BR2_TARGET_LOCALTIME="America/Los_Angeles"

BR2_ROOTFS_DEVICE_CREATION_DYNAMIC_EUDEV=y
BR2_PACKAGE_EUDEV=y

BR2_PACKAGE_LIBDRM=y
BR2_PACKAGE_MESA3D=y
BR2_PACKAGE_MESA3D_GALLIUM_DRIVER_VC4=y
BR2_PACKAGE_MESA3D_OPENGL_EGL=y
BR2_PACKAGE_MESA3D_OPENGL_ES=y

BR2_PACKAGE_GSTREAMER1=y
BR2_PACKAGE_GST1_PLUGINS_BASE_PLUGIN_APP=y
BR2_PACKAGE_GST1_PLUGINS_BASE_PLUGIN_VIDEOCONVERT=y
BR2_PACKAGE_GST1_PLUGINS_GOOD=y
BR2_PACKAGE_GST1_PLUGINS_GOOD_PLUGIN_AUDIOPARSERS=y
BR2_PACKAGE_GST1_PLUGINS_GOOD_PLUGIN_AUTODETECT=y
BR2_PACKAGE_GST1_PLUGINS_GOOD_PLUGIN_DEINTERLACE=y
BR2_PACKAGE_GST1_PLUGINS_GOOD_PLUGIN_ISOMP4=y
BR2_PACKAGE_GST1_PLUGINS_GOOD_PLUGIN_MATROSKA=y
BR2_PACKAGE_GST1_PLUGINS_GOOD_PLUGIN_SOUPHTTPSRC=y
BR2_PACKAGE_GST1_PLUGINS_GOOD_PLUGIN_V4L2=y
BR2_PACKAGE_GST1_PLUGINS_BAD=y
BR2_PACKAGE_GST1_PLUGINS_BAD_PLUGIN_DASH=y
BR2_PACKAGE_GST1_PLUGINS_BAD_PLUGIN_GL=y
BR2_PACKAGE_GST1_PLUGINS_BAD_PLUGIN_HLS=y
BR2_PACKAGE_GST1_PLUGINS_BAD_PLUGIN_LIBMMS=y
BR2_PACKAGE_GST1_PLUGINS_BAD_PLUGIN_MPEGTSDEMUX=y
BR2_PACKAGE_GST1_PLUGINS_BAD_PLUGIN_VIDEOPARSERS=y

BR2_PACKAGE_WPE=y
BR2_PACKAGE_WPE_DEMOS=y
BR2_PACKAGE_DEJAVU=y
BR2_PACKAGE_SHARED_MIME_INFO=y
```

## package/gstreamer1/gst-vaapi/Config.in
```kconfig
config BR2_PACKAGE_GST_VAAPI
	bool "gst-vaapi"
	depends on BR2_PACKAGE_LIBVA
	select BR2_PACKAGE_GST1_PLUGINS_BASE
```

## package/python-mako/Config.in
```kconfig
config BR2_PACKAGE_PYTHON_MAKO
	bool "python-mako"
	help
	  Mako is a template library written in Python.


	  https://pypi.python.org/pypi/Mako
```

## package/x11r7/xkeyboard-config/Config.in
```kconfig
config BR2_PACKAGE_XKEYBOARD_CONFIG
	bool "xkeyboard-config"
	# Runtime dependencies
	select BR2_PACKAGE_XPROTO_XPROTO if BR2_PACKAGE_XORG7
	help
	  keyboard configuration database for X

	  http://xlibs.freedesktop.org/xkbdesc
```
